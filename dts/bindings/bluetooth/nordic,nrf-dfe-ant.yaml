## dts/bindings/bluetooth/nordic,nrf-dfe-ant.yaml
```yaml
# Copyright (c) 2020 Nordic Semiconductor ASA
# SPDX-License-Identifier: Apache-2.0
#
# Note:
#  All dfegpio[n]-pin properties have required property set to false, because it
#  is up to end user which Radio PSEL_GPIO[n] register will be used.
#  Nevertheless there is a requirement that at least two annennae are available.
#  That means at least one dfegpio[n]-pin must be provided, to give Radio
#  possibility to switch between these two antennae.

description: |
    Nordic DFE antennae matrix description

compatible: "nordic,nrf-dfe-ant"

include: [base.yaml]

properties:
    ant-num:
      type: int
      required: true
      description: >
        Number of available antennae.

        Value zero means no antenna available. If provided value different than
        zero, it must be greater or equal to two.

    dfegpio0-pin:
      type: int
      required: false
      description: Pin select for DFE pin 0
    dfegpio1-pin:
      type: int
      required: false
      description: Pin select for DFE pin 1
    dfegpio2-pin:
      type: int
      required: false
      description: Pin select for DFE pin 2
    dfegpio3-pin:
      type: int
      required: false
      description: Pin select for DFE pin 3
    dfegpio4-pin:
      type: int
      required: false
      description: Pin select for DFE pin 4
    dfegpio5-pin:
      type: int
      required: false
      description: Pin select for DFE pin 5
    dfegpio6-pin:
      type: int
      required: false
      description: Pin select for DFE pin 6
    dfegpio7-pin:
      type: int
      required: false
      description: Pin select for DFE pin 7
```

## dts/bindings/net/wireless/nordic,nrf-radio.yaml
```yaml
# Copyright (c) 2020 Nordic Semiconductor ASA
# SPDX-License-Identifier: Apache-2.0

description: |
    Nordic DFE antennas matrix description

    dfegpio[n]-gpios properties provide GPIO pins to Radio peripheral. Provided
    GPIO pins are used to switch antennas e.g. to use 12 antennas 4 GPIO pins
    must be provided, 4 GPIO pins support up to 16 antennas.

    All dfegpio[n]-gpios properties have required property set to false.
    It depends on end user which Radio PSEL_GPIO[n] registers will be used
    to drive antenna switches.
    Nevertheless there is a requirement that at least two antennas are
    available. That means at least one dfegpio[n]-gpios must be provided,
    to give Radio possibility to switch between these two antennas.

compatible: "nordic,nrf-radio"

include: [base.yaml]

properties:
    ant-num:
      type: int
      required: true
      description: |
        Number of available antennas.

        Value zero means no antenna available. If provided value different than
        zero, it must be greater or equal to two.

    dfegpio0-gpios:
      type: phandle-array
      required: false
      description: |
        Pin select for DFE pin 0

        Flags cell in the property is not used for GPIO pin initialization
        and should be set to zero.
    dfegpio1-gpios:
      type: phandle-array
      required: false
      description: |
        Pin select for DFE pin 1

        Flags cell in the property is not used for GPIO pin initialization
        and should be set to zero.

    dfegpio2-gpios:
      type: phandle-array
      required: false
      description: |
        Pin select for DFE pin 2

        Flags cell in the property is not used for GPIO pin initialization
        and should be set to zero.

    dfegpio3-gpios:
      type: phandle-array
      required: false
      description: |
        Pin select for DFE pin 3

        Flags cell in the property is not used for GPIO pin initialization
        and should be set to zero.

    dfegpio4-gpios:
      type: phandle-array
      required: false
      description: |
        Pin select for DFE pin 4

        Flags cell in the property is not used for GPIO pin initialization
        and should be set to zero.

    dfegpio5-gpios:
      type: phandle-array
      required: false
      description: |
        Pin select for DFE pin 5

        Flags cell in the property is not used for GPIO pin initialization
        and should be set to zero.

    dfegpio6-gpios:
      type: phandle-array
      required: false
      description: |
        Pin select for DFE pin 6


        Flags cell in the property is not used for GPIO pin initialization
        and should be set to zero.

    dfegpio7-gpios:
      type: phandle-array
      required: false
      description: |
        Pin select for DFE pin 7

        Flags cell in the property is not used for GPIO pin initialization
        and should be set to zero.
```

## dts/bindings/spi/spi-controller.yaml
```yaml
# Copyright (c) 2018, I-SENSE group of ICCS
# SPDX-License-Identifier: Apache-2.0

# Common fields for SPI controllers

include: base.yaml

bus: spi

properties:
    clock-frequency:
      type: int
      required: false
      description: |
        Clock frequency the SPI peripheral is being driven at, in Hz.
    "#address-cells":
      required: true
      const: 1
    "#size-cells":
      required: true
      const: 0
    label:
      required: true
    cs-gpios:
      type: phandle-array
      required: false
      description: |
        An array of chip select GPIOs to use. Each element
        in the array specifies a GPIO. The index in the array
        corresponds to the child node that the CS gpio controls.

        Example:

          spi@... {
                  cs-gpios = <&gpio0 pin0 flags0>,
                                <&gpio1 pin1 flags1>,
                                ...;

                  spi-device@0 {
                          reg = <0>;
                          ...
                  };
                  spi-device@1 {
                          reg = <1>;
                          ...
                  };
                  ...
          };

        The child node "spi-device@0" specifies a SPI device with
        chip select controller "gpio0", pin "pin0", and devicetree
        GPIO flags "flags0". Similarly, "spi-device@1" has CS GPIO
        controller "gpio1", pin "pin1", and flags "flags1". Additional
        devices can be configured in the same way.

        If this property is not defined, no chip select GPIOs are set.
```

## samples/cpp/hello_world/Kconfig
```kconfig
menu "Hello world C++"

config USE_STD_STRING
  bool "Use std::string type for string storage"
  default n

config USE_STD_IOSTREAM
  bool "Use iostreams for printing. That severly increases use of FLASH memory"
  default y
  select USE_STD_STRING

endmenu # Hello world C++

source "Kconfig.zephyr"
```
